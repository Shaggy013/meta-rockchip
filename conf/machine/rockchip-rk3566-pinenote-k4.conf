## conf/machine/rockchip-rk3566-pinenote-k4.conf
```bitbake
# Copyright (c) 2020, Rockchip Electronics Co., Ltd
# Released under the MIT license (see COPYING.MIT for the terms)

#@TYPE: Machine
#@NAME: RK3566 EVB

require conf/machine/include/rk356x.inc

KERNEL_DEVICETREE = "rockchip/rk3566-rk817-eink-pinenote.dtb"

UBOOT_MACHINE = "quartz64-rk3566_defconfig"

RK_WIFIBT_FIRMWARES = " \
	rkwifibt-firmware-ap6256-wifi \
	rkwifibt-firmware-ap6256-bt \
	brcm-tools \
"

MACHINE_EXTRA_RRECOMMENDS:append = " \
	drm-cursor \
"
```

## conf/machine/rockchip-rk3566-quartz64-k5.conf
```bitbake
# Copyright (c) 2020, Rockchip Electronics Co., Ltd
# Released under the MIT license (see COPYING.MIT for the terms)

#@TYPE: Machine
#@NAME: RK3566 EVB

require conf/machine/include/rk356x-5.inc

KERNEL_DEVICETREE = "rockchip/rk3566-quartz64-a.dtb"

UBOOT_MACHINE = "quartz64-rk3566_defconfig"

RK_WIFIBT_FIRMWARES = " \
	rkwifibt-firmware-ap6256-wifi \
	rkwifibt-firmware-ap6256-bt \
	brcm-tools \
"

MACHINE_EXTRA_RRECOMMENDS:append = " \
	drm-cursor \
"
```
